## boards/arm/jks_sofle/Kconfig.board
```kconfig
#
# Copyright (c) 2024 The ZMK Contributors
# SPDX-License-Identifier: MIT
#

config BOARD_JKS_SOFLE_LEFT
    bool "jks_sofle left"
    depends on SOC_NRF52840_QIAA

config BOARD_JKS_SOFLE_RIGHT
    bool "jks_sofle right"
    depends on SOC_NRF52840_QIAA
```
